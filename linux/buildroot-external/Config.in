## linux/buildroot-external/Config.in
```kconfig
source "$BR2_EXTERNAL_FLOW_PATH/package/flow-gapbs/Config.in"
source "$BR2_EXTERNAL_FLOW_PATH/package/flow-coremark/Config.in"
source "$BR2_EXTERNAL_FLOW_PATH/package/flow-perf/Config.in"
```

## linux/buildroot-external/configs/flow_small_defconfig
```kconfig
BR2_riscv=y
BR2_RISCV_ISA_RVC=y
BR2_TOOLCHAIN_BUILDROOT_MUSL=y
BR2_PACKAGE_HOST_LINUX_HEADERS_CUSTOM_6_18=y
BR2_LINUX_KERNEL=y
BR2_LINUX_KERNEL_CUSTOM_VERSION=y
BR2_LINUX_KERNEL_CUSTOM_VERSION_VALUE="6.18.7"
BR2_LINUX_KERNEL_USE_ARCH_DEFAULT_CONFIG=y
BR2_LINUX_KERNEL_CONFIG_FRAGMENT_FILES="$(BR2_EXTERNAL_FLOW_PATH)/board/flow/linux.fragment"
BR2_LINUX_KERNEL_DTS_SUPPORT=y
BR2_LINUX_KERNEL_INTREE_DTS_NAME="flow/flow-small"
BR2_LINUX_KERNEL_CUSTOM_DTS_DIR="$(BR2_EXTERNAL_FLOW_PATH)/board/flow/dts"
BR2_TARGET_ROOTFS_CPIO=y
BR2_TARGET_ROOTFS_CPIO_GZIP=y
BR2_TARGET_ROOTFS_INITRAMFS=y
BR2_TARGET_GENERIC_GETTY=y
BR2_TARGET_GENERIC_GETTY_PORT="ttyLXU0"
BR2_TARGET_GENERIC_GETTY_BAUDRATE_115200=y
BR2_TARGET_GENERIC_ROOT_PASSWD=""
BR2_ROOTFS_OVERLAY="$(BR2_EXTERNAL_FLOW_PATH)/board/flow/rootfs-overlay"
BR2_TARGET_OPENSBI=y
BR2_TARGET_OPENSBI_CUSTOM_VERSION=y
BR2_TARGET_OPENSBI_CUSTOM_VERSION_VALUE="1.9"
BR2_TARGET_OPENSBI_PLAT="generic"
BR2_TARGET_OPENSBI_INSTALL_JUMP_IMG=y
BR2_TARGET_OPENSBI_ADDITIONAL_VARIABLES="FW_TEXT_START=0x80000000 FW_JUMP_ADDR=0x80200000 FW_JUMP_FDT_ADDR=0x80100000"
```

## linux/buildroot-external/package/flow-coremark/Config.in
```kconfig
config BR2_PACKAGE_FLOW_COREMARK
	bool "Flow CoreMark"
	help
	  CoreMark 1.01 for Linux, compiled with -O3 for the scalar ISA.
```

## linux/buildroot-external/package/flow-gapbs/Config.in
```kconfig
config BR2_PACKAGE_FLOW_GAPBS
	bool "Flow GAP Benchmark Suite"
	depends on BR2_INSTALL_LIBSTDCPP
	depends on BR2_GCC_ENABLE_OPENMP
	help
	  GAPBS graph benchmarks for Breeze. Run with OMP_NUM_THREADS=1
	  on the single-hart design. Includes a small correctness smoke test.
```

## linux/buildroot-external/package/flow-perf/Config.in
```kconfig
config BR2_PACKAGE_FLOW_PERF
	bool "Flow perf sampling smoke"
	depends on BR2_riscv
	help
	  Self-checking scalar workloads and a hardware-event perf record/report
	  check. Requires a CPU implementing the Flow PMU mapping and Sscofpmf.
```
