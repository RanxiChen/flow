/include/ "flow-kcu105-tiny.dts"

/ {
    pmu {
        compatible = "riscv,pmu";
        /* Use overflow-capable HPM3..10 for generic cycles/instructions.
         * Fixed counter0/2 remain architectural CSRs, without sampling IRQ. */
        riscv,event-to-mhpmcounters = <0x1 0x1 0x7f8>, <0x2 0x2 0x7f8>;
        riscv,event-to-mhpmevent = <0x1 0x0 0x10fa>, <0x2 0x0 0x10fb>;
        /* Disjoint masked ranges cover only legal selectors. Keep the table
         * below OpenSBI's 256-entry limit, including generic event rows. */
        riscv,raw-event-to-mhpmcounters =
            <0x0 0x1 0xffffffff 0xffffffff 0x7f8>,
            <0x0 0x2 0xffffffff 0xfffffffe 0x7f8>,
            <0x0 0x4 0xffffffff 0xfffffffc 0x7f8>,
            <0x0 0x8 0xffffffff 0xfffffff8 0x7f8>,
            <0x0 0x10 0xffffffff 0xfffffffc 0x7f8>,
            <0x0 0x14 0xffffffff 0xffffffff 0x7f8>,
            <0x0 0x1000 0xffffffff 0xffffff80 0x7f8>,
            <0x0 0x1080 0xffffffff 0xffffffc0 0x7f8>,
            <0x0 0x10c0 0xffffffff 0xffffffe0 0x7f8>,
            <0x0 0x10e0 0xffffffff 0xfffffff0 0x7f8>,
            <0x0 0x10f0 0xffffffff 0xfffffff8 0x7f8>,
            <0x0 0x10f8 0xffffffff 0xfffffffc 0x7f8>;
    };
};

&cpu0 {
    riscv,isa = "rv64imafdc_zicntr_zicsr_zifencei_zihpm_sscofpmf";
};
